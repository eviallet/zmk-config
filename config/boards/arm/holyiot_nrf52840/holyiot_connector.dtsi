/ {
	holyiot_connector: connector {
		//#gpio-cells = <2>;
		//#gpio-map-mask = <0xffffffff 0xffffffff>;
		//#gpio-map-pass-thru = <0 0x3f>;
		gpio-map = 
			   <0  0 &gpio1 11 0>,
			   <1  0 &gpio1 10 0>,
			   <2  0 &gpio1 13 0>,
			   <3  0 &gpio1 15 0>,
			   <4  0 &gpio0 3 0>,
			   <5  0 &gpio0 2 0>,
			   <6  0 &gpio0 28 0>,
			   <7  0 &gpio0 29 0>,
			   <8  0 &gpio0 30 0>,
			   <9  0 &gpio0 31 0>,
			   <10 0 &gpio0 4 0>,
			   <11 0 &gpio0 5 0>,
			   <12 0 &gpio0 7 0>,
			   <13 0 &gpio1 9 0>,
			   <14 0 &gpio0 12 0>,
			   <15 0 &gpio0 23 0>,
			   <16 0 &gpio0 21 0>,
			   <17 0 &gpio0 19 0>,
			   <18 0 &gpio0 18 0>,
			   <19 0 &gpio0 22 0>,
			   <20 0 &gpio1 0 0>,
			   <21 0 &gpio1 3 0>,
			   <22 0 &gpio1 1 0>,
			   <23 0 &gpio1 2 0>,
			   <24 0 &gpio1 4 0>,
			   <25 0 &gpio1 6 0>,
			   <26 0 &gpio0 9 0>,
			   <27 0 &gpio0 10 0>;
	};

	left_encoder: encoder_left {
        compatible = "alps,ec11";
        label = "ENCODER";
        a-gpios = <&gpio1 9 (GPIO_ACTIVE_HIGH | GPIO_PULL_UP)>;
        b-gpios = <&gpio0 12 (GPIO_ACTIVE_HIGH | GPIO_PULL_UP)>;
        resolution = <4>;
    };


};

