## config/boards/arm/holyiot_nrf52840/Kconfig
```kconfig
config BOARD_ENABLE_DCDC
	bool "Enable DCDC mode"
	select SOC_DCDC_NRF52X
	default y
	depends on BOARD_HOLYIOT_NRF52840

config BOARD_HAS_NRF5_BOOTLOADER
	bool "Board has nRF5 bootloader"
	default y
	help
	  If selected, applications are linked so that they can be loaded by Nordic
	  nRF5 bootloader.
	depends on BOARD_HOLYIOT_NRF52840
```

## config/boards/arm/holyiot_nrf52840/Kconfig.board
```kconfig
config BOARD_HOLYIOT_NRF52840
	bool "Holyiot nRF52840"
	depends on SOC_NRF52840_QIAA
```

## config/boards/arm/holyiot_nrf52840/Kconfig.defconfig
```kconfig
if BOARD_HOLYIOT_NRF52840

	config ZMK_KEYBOARD_NAME
		default "Gueg's keyboard"

	config ZMK_KSCAN_DIRECT_POLLING
		default y

	config BOARD
		default "holyiot_nrf52840"

	config BT_CTLR
		default BT

	config ZMK_BLE
		default y

	config ZMK_USB
		default y

	config USB_NRFX
		default y

	config USB_DEVICE_STACK
		default y

	config ZMK_BATTERY_VOLTAGE_DIVIDER
		default y

endif # BOARD_HOLYIOT_NRF52840
```

## config/boards/arm/holyiot_nrf52840/holyiot_nrf52840_defconfig
```kconfig
# board selection
CONFIG_SOC_SERIES_NRF52X=y
CONFIG_SOC_NRF52840_QIAA=y
CONFIG_BOARD_HOLYIOT_NRF52840=y

# Enable MPU
CONFIG_ARM_MPU=y

# Enable hardware stack protection
CONFIG_HW_STACK_PROTECTION=y

# enable GPIO
CONFIG_GPIO=y

# additional board options
CONFIG_GPIO_AS_PINRESET=y
CONFIG_NFCT_PINS_AS_GPIOS=y

# battery level measurement
CONFIG_ADC=y

# encoder
CONFIG_EC11=y
CONFIG_EC11_TRIGGER_GLOBAL_THREAD=y

# trackball
CONFIG_I2C=y
CONFIG_ZMK_MOUSE=y
CONFIG_ZMK_TRACKBALL_PIM447=y

# bluetooth tx
CONFIG_BT_CTLR_TX_PWR_PLUS_8=y

# memory access configuration
CONFIG_MPU_ALLOW_FLASH_WRITE=y
CONFIG_NVS=y
CONFIG_SETTINGS_NVS=y
CONFIG_FLASH=y
CONFIG_FLASH_PAGE_LAYOUT=y
CONFIG_FLASH_MAP=y

# USB debug
CONFIG_ZMK_USB_LOGGING=y
```

## config/boards/shields/guegs_mk/Kconfig.defconfig
```kconfig
if SHIELD_GUEGS_MK

	config ZMK_KEYBOARD_NAME
		default "Gueg's keyboard"

	config ZMK_KSCAN_DIRECT_POLLING
		default y

endif
```
